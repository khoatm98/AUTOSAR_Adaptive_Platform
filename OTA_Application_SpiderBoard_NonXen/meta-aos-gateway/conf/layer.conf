## OTA_Application_SpiderBoard_NonXen/meta-aos-gateway/conf/layer.conf
```bitbake
# We have a conf and classes directory, add to BBPATH
BBPATH .= ":${LAYERDIR}"

# We have a packages directory, add to BBFILES
BBFILES += "${LAYERDIR}/recipes-*/*/*.bb \
            ${LAYERDIR}/recipes-*/*/*.bbappend"

BBFILE_COLLECTIONS += "rcar-aos-gateway"
BBFILE_PATTERN_rcar-aos-gateway := "^${LAYERDIR}/"
BBFILE_PRIORITY_rcar-aos-gateway = "6"

LAYERSERIES_COMPAT_rcar-aos-gateway = "dunfell"
```
